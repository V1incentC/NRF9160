## CMakeLists.txt
```
# SPDX-License-Identifier: Apache-2.0

cmake_minimum_required(VERSION 3.20.0)

find_package(Zephyr REQUIRED HINTS $ENV{ZEPHYR_BASE})
project(simple_data_sending)

target_sources(app PRIVATE src/main.c)

zephyr_library_sources_ifdef(CONFIG_API_RESPONSE_PARSER_MODULE src/api_response_parser.c)
zephyr_library_sources_ifdef(CONFIG_HTTP_CLIENT_MODULE src/http_client.c)
zephyr_library_sources_ifdef(CONFIG_SHARED_DATA_MODULE src/shared_data.c)
zephyr_library_sources_ifdef(CONFIG_SENSOR_THREAD_MODULE src/sensor_thread.c)
target_sources(app PRIVATE src/thingy91.c)
# if(BOARD STREQUAL thingy91_nrf9160ns)
#     target_sources(app PRIVATE src/thingy91.c)
# endif()
```

## Kconfig
```
# sensor module configuration
config API_RESPONSE_PARSER_MODULE
    bool "Enable Sensor Module"
    default y 

# HTTP client module configuration
config HTTP_CLIENT_MODULE
    bool "Enable HTTP Client Module"
    default y

# Shared data module configuration
config SHARED_DATA_MODULE
    bool "Enable Shared Data Module"
    default y

# Sensor thread module configuration
config SENSOR_THREAD_MODULE
    bool "Enable Sensor Thread Module"
    default y

config BOARD_THINGY91_NRF9160NS
    bool "Enable Thingy91 Board"
    default n
      
menu "Zephyr Kernel"
    source "Kconfig.zephyr"
    endmenu
```

## prj.conf
```kconfig
# nothing here
# Logging
CONFIG_LOG=y
CONFIG_LOG_PRINTK=y
CONFIG_NEWLIB_LIBC=y
CONFIG_FPU=y
CONFIG_NEWLIB_LIBC_FLOAT_PRINTF=y

CONFIG_NRF_MODEM_LIB=y
# CONFIG_NRF_MODEM_LIB_SYS_INIT is deprecated, and kept for compatibility with older NCS versions
CONFIG_NRF_MODEM_LIB_SYS_INIT=n
# CONFIG_LTE_AUTO_INIT_AND_CONNECT is deprecated, and kept for compatibility with older NCS versions
CONFIG_LTE_AUTO_INIT_AND_CONNECT=n
CONFIG_LTE_MODE_PREFERENCE_LTE_M=y
CONFIG_LTE_NETWORK_MODE_LTE_M_NBIOT_GPS=y
CONFIG_UART_INTERRUPT_DRIVEN=y
CONFIG_NETWORKING=y
CONFIG_NET_SOCKETS=y
CONFIG_NET_SOCKETS_POSIX_NAMES=y
CONFIG_NET_NATIVE=n

CONFIG_MODEM_KEY_MGMT=y
CONFIG_LTE_LINK_CONTROL=y
CONFIG_AT_HOST_LIBRARY=y
# PDN library
CONFIG_PDN=y
CONFIG_PDN_ESM_STRERROR=y

CONFIG_NEWLIB_LIBC=y

CONFIG_MAIN_STACK_SIZE=16288
CONFIG_HEAP_MEM_POOL_SIZE=26288

CONFIG_MODEM_INFO=y
CONFIG_JSON_LIBRARY=y


CONFIG_MULTITHREADING=y

CONFIG_HTTP_CLIENT=y

CONFIG_BOARD_THINGY91_NRF9160NS=n

CONFIG_LTE_EDRX_REQ=y
CONFIG_LTE_PSM_REQ_RPTAU="00101000"
CONFIG_LTE_PSM_REQ_RAT="00001000"
```

## thingy91.conf
```kconfig
CONFIG_STDOUT_CONSOLE=y
CONFIG_I2C=y
CONFIG_SENSOR=y
CONFIG_BOOTLOADER_MCUBOOT=y
CONFIG_SIGN_IMAGES=y
```

## src/main.c
```c
/*
 * Copyright (c) 2012-2014 Wind River Systems, Inc.
 *
 * SPDX-License-Identifier: Apache-2.0
 */

#include <zephyr/kernel.h>
#include <modem/modem_info.h>
#include <modem/pdn.h>
#include <modem/nrf_modem_lib.h>
#include <modem/lte_lc.h>
#include <stdio.h>
#include <string.h>
#include <zephyr/logging/log.h>
#include "shared_data.h"
#include "app_config.h"
#include "http_client.h"
#include "sensor_thread.h"
#ifdef CONFIG_BOARD_THINGY91_NRF9160NS
#include "thingy91.h"
#endif	

#define PDN_IPV6_WAIT_MS 1000
K_SEM_DEFINE(pdn_ipv6_up_sem, 0, 1);
LOG_MODULE_REGISTER(Cellfund_Project, LOG_LEVEL_INF);
void print_modem_info(void) {
    char sbuf[128];
	uint16_t mcc, mnc;
    modem_info_string_get(MODEM_INFO_RSRP, sbuf, sizeof(sbuf));
    printk("Signal strength: %s\n", sbuf);

    modem_info_string_get(MODEM_INFO_AREA_CODE, sbuf, sizeof(sbuf));
    printk("Area code: %s\n", sbuf);

	modem_info_string_get(MODEM_INFO_CELLID, sbuf, sizeof(sbuf));
	printk("Cell ID: %s\n", sbuf);

	modem_info_string_get(MODEM_INFO_DATE_TIME, sbuf, sizeof(sbuf));
	printk("Date and time: %s\n", sbuf);

	modem_info_short_get(MODEM_INFO_MCC, &mcc);
	printk("Mobile country code: %d\n", mcc);

	modem_info_short_get(MODEM_INFO_MNC, &mnc);
	printk("Mobile network code: %d\n", mnc);

    modem_info_string_get(MODEM_INFO_BATTERY, sbuf, sizeof(sbuf));
    printk("Battery voltage: %s\n", sbuf);

    modem_info_string_get(MODEM_INFO_FW_VERSION, sbuf, sizeof(sbuf));
    printk("Modem firmware version: %s\n", sbuf);

    modem_info_string_get(MODEM_INFO_IMSI, sbuf, sizeof(sbuf));
    printk("Modem IMSI: %s\n", sbuf);
}

void pdn_event_handler(uint8_t cid, enum pdn_event event, int reason)
{
	struct shared_data *sd = shared_data_get();
	switch (event)
	{
	case PDN_EVENT_CNEC_ESM:
		printk("PDP context %d error, %s\n", cid, pdn_esm_strerror(reason));
		break;
	case PDN_EVENT_ACTIVATED:
		printk("PDP context %d activated\n", cid);
		break;
	case PDN_EVENT_DEACTIVATED:
		printk("PDP context %d deactivated\n", cid);
		break;
	case PDN_EVENT_NETWORK_DETACH:
		printk("PDP context %d network detached\n", cid);
		break;
#if !IS_ENABLED(CONFIG_PDN_DEFAULT_FAM_IPV4)
	case PDN_EVENT_IPV6_UP:
		printk("PDP context %d IPv6 up\n", cid);
		k_sem_give(&pdn_ipv6_up_sem);
		break;
	case PDN_EVENT_IPV6_DOWN:
		printk("PDP context %d IPv6 down\n", cid);
		break;
#endif
	default:
		printk("PDP context %d, unknown event %d\n", cid, event);
		break;
	}
}
void wait_for_ipv6(void) {
#if !IS_ENABLED(CONFIG_PDN_DEFAULT_FAM_IPV4)
    // Get the shared_data structure using shared_data_get()
    struct shared_data *sd = shared_data_get();

    printk("Waiting for IPv6...\n");
    int err = k_sem_take(&pdn_ipv6_up_sem, K_MSEC(PDN_IPV6_WAIT_MS));
    if (err) {
        printk("IPv6 not available\n");
    }
#endif
}

static void lte_handler(const struct lte_lc_evt *const evt)
{
	struct shared_data *sd = shared_data_get();
	switch (evt->type) {
	case LTE_LC_EVT_NW_REG_STATUS:
		if ((evt->nw_reg_status != LTE_LC_NW_REG_REGISTERED_HOME) &&
		     (evt->nw_reg_status != LTE_LC_NW_REG_REGISTERED_ROAMING)) {
			break;
		}

		LOG_INF("Network registration status: %s\n",
			evt->nw_reg_status == LTE_LC_NW_REG_REGISTERED_HOME ?
			"Connected - home network" : "Connected - roaming\n");
		k_sem_give(&sd->lte_connected);
		break;
	case LTE_LC_EVT_PSM_UPDATE:
		LOG_INF("PSM parameter update: TAU: %d, Active time: %d",
			evt->psm_cfg.tau, evt->psm_cfg.active_time);
		if (evt->psm_cfg.active_time == -1){
			LOG_ERR("Network rejected PSM parameters. Failed to enable PSM");
		}
		break;
	case LTE_LC_EVT_EDRX_UPDATE: 
		LOG_INF("eDRX parameter update: eDRX: %f, PTW: %f",
			evt->edrx_cfg.edrx, evt->edrx_cfg.ptw);
		break;
	
	case LTE_LC_EVT_RRC_UPDATE:
		LOG_INF("RRC mode: %s\n",
			evt->rrc_mode == LTE_LC_RRC_MODE_CONNECTED ?
			"Connected" : "Idle\n");
		break;
	case LTE_LC_EVT_CELL_UPDATE:
		LOG_INF("LTE cell changed: Cell ID: %d, Tracking area: %d\n",
		       evt->cell.id, evt->cell.tac);
		break;
	default:
		break;
	}
}
static int modem_configure(void)
{
	int err;

	LOG_INF("Initializing modem library");

	err = nrf_modem_lib_init();
	if (err)
	{
		LOG_ERR("Failed to initialize the modem library, error: %d", err);
		return err;
	}

	// Initialize modem info
	err = modem_info_init();
	if (err)
	{
		printk("Failed to initialize modem info: %d", err);
		return 0;
	}
	/* STEP 8 - Request PSM and eDRX from the network */
	err = lte_lc_psm_req(true);
	if (err) {
		LOG_ERR("lte_lc_psm_req, error: %d", err);
	}
	err = lte_lc_edrx_req(true);
	if (err) {
		LOG_ERR("lte_lc_edrx_req, error: %d", err);
	}

	LOG_INF("Connecting to LTE network");

	/* Setup a callback for the default PDP context (zero).
	 * Do this before switching to function mode 1 (CFUN=1)
	 * to receive the first activation event.
	 */
	err = pdn_default_ctx_cb_reg(pdn_event_handler);
	if (err)
	{
		printk("pdn_default_ctx_cb_reg() failed, err %d\n", err);
		return 0;
	}

	err = lte_lc_init_and_connect_async(lte_handler);
	if (err)
	{
		LOG_ERR("Modem could not be configured, error: %d", err);
		return err;
	}

	// /* Decativate LTE and enable GNSS. */
	// err = lte_lc_func_mode_set(LTE_LC_FUNC_MODE_DEACTIVATE_LTE);
	// if (err)
	// {
	// 	LOG_ERR("Failed to decativate LTE and enable GNSS functional mode");
	// 	return err;
	// }

	return 0;
}

int main(void)
{
	int err;
    char imei[IMEI_BUF_SIZE];

    printk("HTTPS client sample started\n\r");
	shared_data_init();
	struct shared_data *sd = shared_data_get();
	#ifdef CONFIG_BOARD_THINGY91_NRF9160NS
	thingy91_sensors_init();
	#endif
	err = modem_configure();
	if (err) {
		LOG_ERR("Failed to configure the modem");
		return 0;
	}
	k_sem_take(&sd->lte_connected, K_FOREVER);
	// Print modem information
    print_modem_info();
	// Get IMEI
    err = modem_info_string_get(MODEM_INFO_IMEI, imei, sizeof(imei));
    if (err < 0) {
        printk("Failed to get IMEI, error: %d\n", err);
        return err;
    }
	fetch_and_parse_json_response(imei);
	printk("Received data: %s\n", sd->response_buf);
	err = lte_lc_func_mode_set(LTE_LC_FUNC_MODE_DEACTIVATE_LTE);
	if (err != 0){
		LOG_ERR("Failed to decativate LTE and enable GNSS functional mode");
		
	}
	//sensor_thread_start();
	
	return 0;
}
```

## src/api_response_parser.c
```c
// api_response_parser.c
#include "api_response_parser.h"

int api_response_parser_json(const char *response, struct api_response *resp) {

	int err;

	/* Find the start of the JSON body */
	char *json_start = strstr(response, "{");
	if (json_start == NULL) {
		return -1;
	}

	/* Find the end of the JSON body */
	char *json_end = strrchr(json_start, '}');
	if (json_end == NULL) {
		return -1;
	}
	json_end++; // Include the closing brace

	/* Parse JSON response */
	err = json_obj_parse(json_start, json_end - json_start, response_descr,
						 ARRAY_SIZE(response_descr), resp);
	if (err < 0) {
		return err;
	}

	return 0;
}
```

## src/api_response_parser.h
```c
// api_response_parser.h
#ifndef API_RESPONSE_PARSER_H
#define API_RESPONSE_PARSER_H

#include <zephyr/data/json.h>


struct api_settings {
    const char* ci;
    const char* c1;
    struct json_obj_token o1;
    struct json_obj_token o2;
    struct json_obj_token f1;
    struct json_obj_token f2;
    const char* gp;
    const char* ac;
    int at;
    const char* we;
    int wa;
    int al;
    int ui;
    const char* ah;
    const char* df;
    const char* te;
    const char* ap;
    const char* hs;
    bool go;
    int tz;
    const char* ps;
    const char* us;
    int zs;
    int ks;
    const char* ln;
};

struct api_response {
    struct api_settings settings[1];
    size_t settings_len;
};

static const struct json_obj_descr api_settings_descr[] = {
    JSON_OBJ_DESCR_PRIM(struct api_settings, ci, JSON_TOK_STRING),
    JSON_OBJ_DESCR_PRIM(struct api_settings, c1, JSON_TOK_STRING),
    JSON_OBJ_DESCR_PRIM(struct api_settings, o1, JSON_TOK_FLOAT ),
    JSON_OBJ_DESCR_PRIM(struct api_settings, o2, JSON_TOK_FLOAT ),
    JSON_OBJ_DESCR_PRIM(struct api_settings, f1, JSON_TOK_FLOAT ),
    JSON_OBJ_DESCR_PRIM(struct api_settings, f2, JSON_TOK_FLOAT ),
    JSON_OBJ_DESCR_PRIM(struct api_settings, gp, JSON_TOK_STRING),
    JSON_OBJ_DESCR_PRIM(struct api_settings, ac, JSON_TOK_STRING),
	JSON_OBJ_DESCR_PRIM(struct api_settings, at, JSON_TOK_NUMBER),
	JSON_OBJ_DESCR_PRIM(struct api_settings, we, JSON_TOK_STRING),
	JSON_OBJ_DESCR_PRIM(struct api_settings, wa, JSON_TOK_NUMBER),
	JSON_OBJ_DESCR_PRIM(struct api_settings, al, JSON_TOK_NUMBER),
	JSON_OBJ_DESCR_PRIM(struct api_settings, ui, JSON_TOK_NUMBER),
	JSON_OBJ_DESCR_PRIM(struct api_settings, ah, JSON_TOK_STRING),
    JSON_OBJ_DESCR_PRIM(struct api_settings, df, JSON_TOK_STRING),
    JSON_OBJ_DESCR_PRIM(struct api_settings, te, JSON_TOK_STRING),
    JSON_OBJ_DESCR_PRIM(struct api_settings, ap, JSON_TOK_STRING),
    JSON_OBJ_DESCR_PRIM(struct api_settings, hs, JSON_TOK_STRING),
    JSON_OBJ_DESCR_PRIM(struct api_settings, go, JSON_TOK_TRUE),
    JSON_OBJ_DESCR_PRIM(struct api_settings, tz, JSON_TOK_NUMBER),
    JSON_OBJ_DESCR_PRIM(struct api_settings, ps, JSON_TOK_STRING),
    JSON_OBJ_DESCR_PRIM(struct api_settings, us, JSON_TOK_STRING),
    JSON_OBJ_DESCR_PRIM(struct api_settings, zs, JSON_TOK_NUMBER),
    JSON_OBJ_DESCR_PRIM(struct api_settings, ks, JSON_TOK_NUMBER),
    JSON_OBJ_DESCR_PRIM(struct api_settings, ln, JSON_TOK_STRING)
};

static const struct json_obj_descr response_descr[] = {
    JSON_OBJ_DESCR_OBJ_ARRAY(struct api_response, settings, 1,
                             settings_len, api_settings_descr,
                             ARRAY_SIZE(api_settings_descr)),
};

int api_response_parser_json(const char *response, struct api_response *resp);

#endif // API_RESPONSE_PARSER_H
```

## src/app_config.h
```c
// app_config.h
#ifndef APP_CONFIG_H
#define APP_CONFIG_H


#define HTTP_PORT 443
#define HTTPS_PORT "443"
#define HTTPS_HOSTNAME "api.beescale.io"
#define HTTP_REQUEST_BUF_SIZE 1024
#define HTTP_RESPONSE_BUF_SIZE 2048
#define HTTP_URL_BUF_SIZE 512

#define IMEI_BUF_SIZE 36

#endif // APP_CONFIG_H
```

## src/http_client.c
```c
// http_client.c
#include "http_client.h"
#include "api_response_parser.h"
#include "app_config.h"
#include "shared_data.h"
#include <zephyr/net/socket.h>
#include <zephyr/net/tls_credentials.h>
#include <zephyr/net/http/client.h>
#include <modem/nrf_modem_lib.h>
#include <modem/modem_key_mgmt.h>
#include <stdio.h>
#include <string.h>
#include <stdlib.h>


#define TLS_SEC_TAG 42
#define PDN_IPV6_WAIT_MS 1000

/* Certificate for `api.beescales.com` */
static const char cert[] = {
#include "../cert/lets-encrypt-r3"
};
/* Setup TLS options on a given socket */
static int tls_setup(int fd)
{
	int err;
	int verify;

	/* Security tag that we have provisioned the certificate with */
	const sec_tag_t tls_sec_tag[] = {
		TLS_SEC_TAG,
	};

#if defined(CONFIG_SAMPLE_TFM_MBEDTLS)
	err = tls_credential_add(tls_sec_tag[0], TLS_CREDENTIAL_CA_CERTIFICATE, cert, sizeof(cert));
	if (err)
	{
		return err;
	}
#endif

	/* Set up TLS peer verification */
	enum
	{
		NONE = 0,
		OPTIONAL = 1,
		REQUIRED = 2,
	};

	verify = REQUIRED;

	err = setsockopt(fd, SOL_TLS, TLS_PEER_VERIFY, &verify, sizeof(verify));
	if (err)
	{
		printk("Failed to setup peer verification, err %d\n", errno);
		return err;
	}

	/* Associate the socket with the security tag
	 * we have provisioned the certificate with.
	 */
	err = setsockopt(fd, SOL_TLS, TLS_SEC_TAG_LIST, tls_sec_tag, sizeof(tls_sec_tag));
	if (err)
	{
		printk("Failed to setup TLS sec tag, err %d\n", errno);
		return err;
	}

	err = setsockopt(fd, SOL_TLS, TLS_HOSTNAME, HTTPS_HOSTNAME, sizeof(HTTPS_HOSTNAME) - 1);
	if (err)
	{
		printk("Failed to setup TLS hostname, err %d\n", errno);
		return err;
	}
	return 0;
}
static void http_response_cb(struct http_response *rsp, enum http_final_call final_data, void *user_data) {
	
	struct shared_data *sd = shared_data_get();
    /* Handle the response data here */
	/* Print the response data */
    //printk("Received data:\n%.*s\n", rsp->data_len, rsp->body_frag_start);
	/* Copy the response data */
	k_mutex_lock(&sd->url_mutex, K_FOREVER);
	memcpy(sd->response_buf, rsp->body_frag_start, rsp->body_frag_len);
	sd->response_len = rsp->body_frag_len;
	k_mutex_unlock(&sd->url_mutex);
	/* Signal the semaphore */
	k_sem_give(&sd->http_response_sem);
}

int http_client_send_get_request(const char *url) {
    int err;
    int fd;
    struct addrinfo *res;
    struct addrinfo hints = {
        .ai_family = AF_INET,
        .ai_socktype = SOCK_STREAM,
    };
    struct http_request req = {0};
    static uint8_t recv_buf[HTTP_RESPONSE_BUF_SIZE];
	struct shared_data *sd = shared_data_get();

	k_mutex_lock(&sd->url_mutex, K_FOREVER);
    /* Format HTTP request */
    req.method = HTTP_GET;
    req.url = url;
    req.host = HTTPS_HOSTNAME;
    req.protocol = "HTTP/1.1";
    req.response = http_response_cb;
    req.recv_buf = recv_buf;
    req.recv_buf_len = sizeof(recv_buf);
	k_mutex_unlock(&sd->url_mutex);

    /* Resolve hostname */
    err = getaddrinfo(HTTPS_HOSTNAME, HTTPS_PORT, &hints, &res);
    if (err) {
        printk("Failed to resolve hostname %s, error: %d\n", HTTPS_HOSTNAME, err);
        return err;
    }

    /* Create socket */
    fd = socket(res->ai_family, SOCK_STREAM, IPPROTO_TLS_1_2);
    if (fd < 0) {
        printk("Failed to create socket, error: %d\n", errno);
        err = -errno;
        goto clean_up;
    }

	/* Setup TLS socket options */
	err = tls_setup(fd);
	if (err) {
		goto clean_up;
	}

	/* Connect to server */
	((struct sockaddr_in *)res->ai_addr)->sin_port = htons(HTTP_PORT);
	err = connect(fd, res->ai_addr, res->ai_addrlen);
	if (err < 0) {
		printk("Failed to connect to server, error: %d\n", errno);
		err = -errno;
		goto clean_up;
	}

	/* Send HTTP request */
	err = http_client_req(fd, &req, 5000, NULL);
	if (err < 0) {
		printk("Failed to send HTTP request, error: %d\n", errno);
		err = -errno;
		goto clean_up;
	}

clean_up:
	freeaddrinfo(res);
	close(fd);

	return err;
}

void fetch_and_parse_json_response(const char *imei) {

    struct shared_data *sd = shared_data_get(); // Get shared data instance

    char url[HTTP_URL_BUF_SIZE];
    snprintf(url, sizeof(url), "/v3.0/config?id=%s", imei);

    int err = http_client_send_get_request(url); // Use shared data instance
    if (err < 0) {
        printk("Failed to get JSON response from server, error: %d\n", err);
        return;
    }

    k_sem_take(&sd->http_response_sem, K_FOREVER);
	k_mutex_lock(&sd->url_mutex, K_FOREVER);
    printk("Received JSON response (%d bytes):\n%s\n", sd->response_len, sd->response_buf);

    // Parse JSON response
    api_response_parser_json(sd->response_buf, &sd->json_response);
	k_mutex_unlock(&sd->url_mutex);
    memcpy(sd->api_key, sd->json_response.settings[0].c1, sizeof(sd->api_key));
    printk("Extracted c1 key: %s\n", sd->api_key);
    k_sem_give(&sd->api_key_sem);
}
```

## src/http_client.h
```c
// http_client.h
#ifndef HTTP_CLIENT_H
#define HTTP_CLIENT_H

#include <zephyr/net/http/client.h>
#include "api_response_parser.h"



struct request_fields {
    uint16_t field1;  // Battery (mV)
    int16_t field2;   // Signal Strength (dBm)
    int16_t field3;   // Temperature (*C)
    uint32_t field4;  // Pressure (Pa)
    uint32_t field5;  // Humidity (%)
    uint32_t field6;  // Weight (grams)
    uint32_t field7;  // Placeholder for Field7
    uint32_t field8;  // Placeholder for Field8
};


int http_client_send_get_request(const char *url);
void fetch_and_parse_json_response(const char *imei);
#endif // HTTP_CLIENT_H
```

## src/sensor_thread.c
```c
// sensor_thread.c
#include "sensor_thread.h"
#include "http_client.h"
#include "shared_data.h"
#include <stdio.h>
#include <modem/modem_info.h>
#include <modem/lte_lc.h>
#ifdef CONFIG_BOARD_THINGY91_NRF9160NS
#include "thingy91.h"
#include <zephyr/drivers/sensor.h>
#endif

#define STACKSIZE 4*1024
#define THREAD_PRIORITY 5
#define SLEEP_TIME K_MINUTES(2)

K_THREAD_STACK_DEFINE(sensor_thread_stack_area, STACKSIZE);
struct k_thread sensor_thread_data;


void sensor_thread_send_func(void *arg1, void *arg2, void *arg3)
{
    
    ARG_UNUSED(arg1);
    ARG_UNUSED(arg2);
    ARG_UNUSED(arg3);

    char url[HTTP_URL_BUF_SIZE];  // Define the url buffer here
    char sbuf[128];
    int16_t signal_strength;
    uint16_t battery_voltage;

    struct shared_data *sd = shared_data_get();
    
    // Fetch the semaphores from the shared data
    struct k_sem *api_key_sem = &sd->api_key_sem;
    struct k_sem *http_response_sem = &sd->http_response_sem;
    struct k_mutex  *url_mutex = &sd-> url_mutex;

	k_sem_take(api_key_sem, K_FOREVER);
	printk("Hello from sensor thread\n");

	while (1) {
        int err;
        printk("Sensor thread: connecting to network\n");
        /* Activate LTE and connect to the LTE network */
        err = lte_lc_func_mode_set(LTE_LC_FUNC_MODE_NORMAL);
		if (err != 0){
			printk("Failed to activate LTE");
			break;
		}
		k_sem_take(&sd->lte_connected, K_FOREVER);
		printk("Sensor thread: semaphore taken\n");
        #ifdef CONFIG_BOARD_THINGY91_NRF9160NS
        // Get Sensor Data
        struct sensor_value temp, press, humidity, gas_res;
        get_sensor_data(&temp, &press, &humidity, &gas_res);
        
        modem_info_string_get(MODEM_INFO_RSRP, sbuf, sizeof(sbuf));
        printk("Signal strength: %s\n", sbuf);
        sscanf(sbuf, "%d", &signal_strength);

        modem_info_string_get(MODEM_INFO_BATTERY, sbuf, sizeof(sbuf));
        printk("Battery voltage: %s\n", sbuf);
        sscanf(sbuf, "%hu", &battery_voltage);
        /* Format URL with query parameters */
		k_mutex_lock(url_mutex, K_FOREVER);
		snprintf(url, sizeof(url),
                 "/update.json?api_key=%s&field1=%hu&field2=%d&field3=%d.%06d&field4=%d.%06d&field5=%d.%06d",
                 sd->api_key,
                 battery_voltage,
                 signal_strength,
                 temp.val1, temp.val2,
                 press.val1*10, press.val2*10,
                 humidity.val1, humidity.val2);
		
        /* Clear the response buffer */
        memset(sd->response_buf, 0, sizeof(sd->response_buf));
        k_mutex_unlock(url_mutex);

#else
        // Generate random data for fields when Thingy:91 is not defined
        int temp_val = k_cycle_get_32() % 100;
        int press_val = k_cycle_get_32() % 1000;
        int humidity_val = k_cycle_get_32() % 50;
        int gas_res_val = k_cycle_get_32() % 500;
        signal_strength = -80;  // Default signal strength
        battery_voltage = 3700; // Default battery voltage
        k_mutex_lock(url_mutex, K_FOREVER);
		snprintf(url, sizeof(url),
                 "/update.json?api_key=%s&field1=%hu&field2=%d&field3=%d&field4=%d&field5=%d",
                 sd->api_key,
                 battery_voltage,
                 signal_strength,
                 temp_val,
                 press_val,
                 humidity_val);
		
        /* Clear the response buffer */
        memset(sd->response_buf, 0, sizeof(sd->response_buf));
        k_mutex_unlock(url_mutex);
#endif

		
        
		/* Send GET request and get response */
		err = http_client_send_get_request(url);
		if (err < 0) {
			printk("Failed to get response from server, error:%d", err);
			//return;
		}
        
		/* Wait for the response data */
		k_sem_take(http_response_sem, K_FOREVER);
        k_mutex_lock(url_mutex, K_FOREVER);
		/* Print the response data */
		printk("Received response (%d bytes):\n%s\n", sd->response_len, sd->response_buf);
        k_mutex_unlock(url_mutex);


        err = lte_lc_func_mode_set(LTE_LC_FUNC_MODE_DEACTIVATE_LTE);
		if (err != 0){
			printk("Failed to decativate LTE and enable GNSS functional mode");
			break;
		}
        k_sleep(SLEEP_TIME);
        
    }
}

void sensor_thread_start(void) {
    // ... Create and start sensor thread ...
    k_thread_create(&sensor_thread_data, sensor_thread_stack_area,
                    STACKSIZE,
                    sensor_thread_send_func, NULL, NULL, NULL,
                    THREAD_PRIORITY, 0, K_NO_WAIT);
}
```

## src/sensor_thread.h
```c
// sensor_thread.h
#ifndef SENSOR_THREAD_H
#define SENSOR_THREAD_H

void sensor_thread_start(void);

#endif // SENSOR_THREAD_H
```

## src/shared_data.c
```c
// shared_data.c
#include "shared_data.h"

static struct shared_data shared_data_instance;

void shared_data_init(void) {
    k_sem_init(&shared_data_instance.api_key_sem, 0, 1);
    k_sem_init(&shared_data_instance.http_response_sem, 0, 1);
    k_sem_init(&shared_data_instance.lte_connected, 0, 1);
    k_mutex_init(&shared_data_instance.url_mutex);
    
    // Initialize other shared data here
}

struct shared_data *shared_data_get(void) {
    return &shared_data_instance;
}
```

## src/shared_data.h
```c
// shared_data.h
#ifndef SHARED_DATA_H
#define SHARED_DATA_H

#include <zephyr/kernel.h>
#include "app_config.h"
#include "api_response_parser.h"

struct shared_data {
    struct k_sem api_key_sem;
    struct k_sem http_response_sem;
    struct k_mutex url_mutex;
    struct k_sem lte_connected;
    char response_buf[HTTP_RESPONSE_BUF_SIZE]; // Include response here
    int response_len;
    char api_key[17];
    struct api_response json_response;
    // Add more shared data here
};

void shared_data_init(void);
struct shared_data *shared_data_get(void);

#endif // SHARED_DATA_H
```

## src/thingy91.c
```c
#include <zephyr/kernel.h>
#include <zephyr/device.h>
#include <zephyr/drivers/sensor.h>
#include <stdio.h>
#include "thingy91.h"
#ifdef CONFIG_BOARD_THINGY91_NRF9160NS
const struct device *const dev = DEVICE_DT_GET_ONE(bosch_bme680);

void get_sensor_data(struct sensor_value *temp, struct sensor_value *press, struct sensor_value *humidity, struct sensor_value *gas_res)
{
    if (!device_is_ready(dev)) {
        printk("sensor: device not ready.\n");
        return;
    }

    sensor_sample_fetch(dev);
    sensor_channel_get(dev, SENSOR_CHAN_AMBIENT_TEMP, temp);
    sensor_channel_get(dev, SENSOR_CHAN_PRESS, press);
    sensor_channel_get(dev, SENSOR_CHAN_HUMIDITY, humidity);
    sensor_channel_get(dev, SENSOR_CHAN_GAS_RES, gas_res);
}

int thingy91_sensors_init()
{
    if (!device_is_ready(dev)) {
		printk("sensor: device not ready.\n");
		return 0;
	}
    printf("Device %p name is %s\n", dev, dev->name);
    return 1;
}
#endif
```

## src/thingy91.h
```c
#ifndef THINGY91_H_
#define THINGY91_H_

#ifdef __cplusplus
extern "C" {
#endif
#include <zephyr/drivers/sensor.h>

#ifdef CONFIG_BOARD_THINGY91_NRF9160NS
void get_sensor_data(struct sensor_value *temp, struct sensor_value *press, struct sensor_value *humidity, struct sensor_value *gas_res);
int thingy91_sensors_init();
#endif

#ifdef __cplusplus
}
#endif

#endif /* THINGY91_H_ */
```
